## service-alerts-device/components/iotcore/system/firmware_updates/delta_ota/Kconfig
```kconfig
menu "Delta OTA config"

    config ENABLE_DELTA_OTA
        bool "Enable support for Delta OTA"
        default n
        help
            Enable or disable support for Delta OTA
    
    config DELTA_MAGIC
        int "Magic word for Delta OTA"
        default 4241350160
        range 0 4294967295
        help
            Image Magic given as first 4 bytes of image header
    
        
endmenu
```

## service-alerts-device/components/iotcore/test/Kconfig
```kconfig
menu "IoT Core - Unit Tests"
    menu "Hardware Unit Tests"
        menu "Peripheral Unit Tests"
            config UNIT_TEST_I2c
            bool "Enable I2C unit Testing"
            default n
        endmenu
    endmenu

endmenu
```

## service-alerts-device/components/iotcore/utils/Kconfig
```kconfig
menu "Utils"
    config ENABLE_JSON
        bool "Enable JSON"
        default y
        help
            Enable or disable JSON.

    config ENABLE_ERROR_HANDLING
        bool "Enable Error handling"
        default y
        help
            Enable or disable error handling.

    config ENABLE_DC_CODES
        bool "Enable DC Codes"
        default y
        help
            Enable or disable DC codes.

    config ENABLE_UTILITY
        bool "Enable Utility"
        default y
        help 
            Enable or disable Utility

    config ENABLE_URL_ENCODING
        bool "Enable URL Encoding"
        default y
        help 
            Enable or disable URL Encoding.
endmenu
```
