## service-alerts-device/components/iotcore/networking/connectivity/modem/Kconfig
```kconfig
menu "Modem Configuration"
    rsource "esp_modem/Kconfig"
    choice MODEM_SERIAL_CONFIG
        prompt "Type of serial connection to the modem"
        default MODEM_SERIAL_CONFIG_UART
        config MODEM_SERIAL_CONFIG_UART
            bool "UART"
            help
                Connect to modem via UART.
        config MODEM_SERIAL_CONFIG_USB
            bool "USB"
            depends on IDF_TARGET_ESP32S2 || IDF_TARGET_ESP32S3
            help
                Connect to modem via USB (CDC-ACM class). For IDF version >= 4.4.
    endchoice
    config MODEM_PPP_APN
        string "Set MODEM APN"
        default "internet"
        help
            Set APN (Access Point Name), a logical name to choose data network

    choice FLOW_CONTROL
        bool "Set preferred modem control flow"
        default FLOW_CONTROL_NONE
        help
            Set the modem's preferred control flow

        config FLOW_CONTROL_NONE
            bool "No control flow"
        config FLOW_CONTROL_SW
            bool "SW control flow"
        config FLOW_CONTROL_HW
            bool "HW control flow"
    endchoice

    menu "UART Configuration"
        config MODEM_UART_TX_PIN
            int "TXD Pin Number"
            default 25
            range 0 31
            help
                Pin number of UART TX.

        config MODEM_UART_RX_PIN
            int "RXD Pin Number"
            default 26
            range 0 31
            help
                Pin number of UART RX.

        config MODEM_UART_RTS_PIN
            int "RTS Pin Number"
            default 27
            range 0 31
            help
                Pin number of UART RTS.

        config MODEM_UART_CTS_PIN
            int "CTS Pin Number"
            default 23
            range 0 31
            help
                Pin number of UART CTS.
    endmenu
    
    menu "MODEM_POWER_CONTROL"
        config MODEM_PWRKEY
            int "Pin number for pwrkey"
            default -1
            help
              This be the pin number that will be used to control power to the modem. 
              If not used set -1 but POWER_SWITCH_KEY will be required
        config MODEM_POWER_SWITCH_KEY
            int "Pin number for high side switch of modem"
            default 9
            help
              This pin will be used to control power to the modem if pwrkey is not defined
        
    endmenu

    config EXAMPLE_USE_VFS_TERM
        bool "Use VFS terminal"
        default n
        help
            Demonstrate use of VFS as a communication terminal of the DTE.
            VFS driver implements non-block reads, writes and selects to communicate with esp-modem,
            but this implementation uses UART resource only.

endmenu
```

## service-alerts-device/components/iotcore/networking/connectivity/wifi/Kconfig
```kconfig
menu "WiFi Configuration"

    choice WIFI_POWER_SAVE_MODE
        prompt "Power Saving Mode"
        default WIFI_POWER_SAVE_MIN_MODEM
        help
            Power save mode for the esp32 to use. Modem sleep mode includes minimum and maximum power save modes.
            In minimum power save mode, station wakes up every DTIM to receive beacon. Broadcast data will not be
            lost because it is transmitted after DTIM. However, it can not save much more power if DTIM is short
            for DTIM is determined by AP.
            In maximum power save mode, station wakes up every listen interval to receive beacon. Broadcast data
            may be lost because station may be in sleep state at DTIM time. If listen interval is longer, more power
            is saved but broadcast data is more easy to lose.

        config WIFI_POWER_SAVE_NONE
            bool "None"
        config WIFI_POWER_SAVE_MIN_MODEM
            bool "Minimum Power Saving"
        config WIFI_POWER_SAVE_MAX_MODEM
            bool "Maximum Power Saving"
    endchoice

    config IOTCORE_DEFAULT_WIFI
        bool "Enable default wifi"
        default false
        help
            use this to enable default configurable wifi besides the "Cowlar Test".

    config IOTCORE_WIFI_DEFAULT_SSID
        string "Default ssid"
        default "IOTCORE Test"
        depends on IOTCORE_DEFAULT_WIFI
        help
            Default wifi ssid which can be used to conect device to the internet if no wifis are on it.

    config IOTCORE_WIFI_DEFAULT_PASS
        string "Default Pass"
        default "12345677"
        depends on IOTCORE_DEFAULT_WIFI
        help
            Password for the default ssid.

endmenu
```

## service-alerts-device/components/iotcore/networking/eppp_link/Kconfig
```kconfig
menu "eppp_link"

    config EPPP_LINK_USES_LWIP
        bool "Enable LWIP for EPPP"
        default "y"
        select LWIP_PPP_SUPPORT
        select LWIP_PPP_SERVER_SUPPORT
        help
            Enable LWIP PPP support for EPPP.

    choice EPPP_LINK_DEVICE
        prompt "Choose PPP transport device"
        default EPPP_LINK_DEVICE_UART
        help
            Select the transport peripheral to use for PPP link.

        config EPPP_LINK_DEVICE_UART
            bool "UART"
            help
                Use UART for PPP link.

        config EPPP_LINK_DEVICE_SPI
            bool "SPI"
            help
                Use SPI for PPP link.

        config EPPP_LINK_DEVICE_SDIO
            bool "SDIO"
            depends on SOC_SDMMC_HOST_SUPPORTED || SOC_SDIO_SLAVE_SUPPORTED
            help
                Use SDIO for PPP link.

    endchoice

    if EPPP_LINK_DEVICE_UART
        config EPPP_UART_BAUD_RATE
            int "UART baud rate"
            default 921600
            help
                Set the baud rate for UART.

        config EPPP_UART_TX_IO
            int "UART TX IO"
            default 5
            help
                GPIO number for UART TX.

        config EPPP_UART_RX_IO
            int "UART RX IO"
            default 7
            help
                GPIO number for UART RX.

        config EPPP_UART_PORT
            int "UART Port number"
            default 1
            range 0 2
            help
                UART Port Number.

        config EPPP_UART_QUEUE_SIZE
            int "UART queue size"
            default 32
            help
                Queue size for uart events.

        config EPPP_UART_RX_BUFFER_SIZE
            int "UART RX buffer size"
            default 2048
            help
                Receive buffer maximum size.
        
    endif

    if EPPP_LINK_DEVICE_SPI
        config EPPP_SPI_HOST
            int "SPI host number"
            default 1
            help
                SPI host number (HSPI or VSPI).

        config EPPP_SPI_MOSI_IO
            int "SPI MOSI IO"
            default 11
            help
                GPIO number for SPI MOSI.

        config EPPP_SPI_MISO_IO
            int "SPI MISO IO"
            default 13
            help
                GPIO number for SPI MISO.

        config EPPP_SPI_SCLK_IO
            int "SPI SCLK IO"
            default 12
            help
                GPIO number for SPI SCLK.

        config EPPP_SPI_CS_IO
            int "SPI CS IO"
            default 10
            help
                GPIO number for SPI CS.

        config EPPP_SPI_INTR_IO
            int "SPI interrupt IO"
            default 2
            help
                GPIO number for SPI interrupt.

        config EPPP_SPI_FREQ
            int "SPI frequency (Hz)"
            default 16000000
            help
                Frequency for SPI communication.
    endif

    if EPPP_LINK_DEVICE_SDIO
        config EPPP_SDIO_WIDTH
            int "SDIO width"
            default 4
            help
                SDIO bus width.

        config EPPP_SDIO_CLK_IO
            int "SDIO clock IO"
            default 18
            help
                GPIO number for SDIO clock.

        config EPPP_SDIO_CMD_IO
            int "SDIO command IO"
            default 19
            help
                GPIO number for SDIO command.

        config EPPP_SDIO_D0_IO
            int "SDIO D0 IO"
            default 49
            help
                GPIO number for SDIO D0 line.

        config EPPP_SDIO_D1_IO
            int "SDIO D1 IO"
            default 50
            help
                GPIO number for SDIO D1 line.

        config EPPP_SDIO_D2_IO
            int "SDIO D2 IO"
            default 16
            help
                GPIO number for SDIO D2 line.

        config EPPP_SDIO_D3_IO
            int "SDIO D3 IO"
            default 17
            help
                GPIO number for SDIO D3 line.
    endif

    menu "Task Configuration"

        config EPPP_TASK_STACK_SIZE
            int "Task stack size"
            default 4096
            help
                Set the stack size for the EPPP task.

        config EPPP_TASK_PRIORITY
            int "Task priority"
            default 8
            help
                Set the priority for the EPPP task.
    endmenu

    menu "PPP Configuration"
        config EPPP_SERVER_IP
            string "EPPP Server IP"
            default "192.168.11.1"
            help
                IP address for the EPPP server.

        config EPPP_CLIENT_IP
            string "EPPP Client IP"
            default "192.168.11.2"
            help
                IP address for the EPPP client.
    endmenu

endmenu
```

## service-alerts-device/components/iotcore/networking/protocols/REST_API_CLIENT/Kconfig
```kconfig
menu "HTTP REST Client"

  config HTTP_REST_CLIENT_USER_AGENT
    string "User Agent"
    default "IDF HTTP REST Client/1.0"
    help
      This is the User Agent string to be used by the client.

  config HTTP_REST_CLIENT_RECEIVE_BUFFER_SIZE
    int "Receive Buffer Size"
    default 512
    help
      HTTP REST client receive buffer size

  config HTTP_REST_CLIENT_USE_LOCK  
    bool "Use lock to allow single client request at a time"  
    default y  
    help  
      Enable this option to use a semaphore for managing HTTP REST client requests.  
      When enabled, only one request will be processed at a time.  
    
endmenu
```

## service-alerts-device/components/iotcore/networking/protocols/mqtt/Kconfig
```kconfig
menu "MQTT_APPLICATION_CONFIGURATION"
    config MQTT_RECONNECT_TIMEOUT
        int "Time in ms (Reconnect to the broker after this value in miliseconds if auto reconnect is not disabled)"
        default 10000
    config MQTT_REFRESH_CONNECTION_MS
        int "Refresh connection after this value (in milliseconds), default 30 mins"
        default 1800000
    config MQTT_KEEPALIVE_INTERVAL
        int "Keepalive interval of the client. keeping this too low might cause frequent disconnections and keeing it too high will result in delayed disconnections"
        default 10
    config MQTT_RETRANSMIT_TIMEOUT
        int "timeout for retransmitting of failed packet"
        default 1000
    config MQTT_TASK_PRIORITY
        int "Task priority for MQTT internal task"
        default 5
    config MQTT_TASK_STACK_SIZE
        int "Task stack size internal for mqtt"
        default 6144
    config MQTT_BUFFER_SIZE
        int "MQTT buffer size for incoming and outgoing messages"
        default 1024

    config MQTT_USE_MAC_ADDRESS_AS_DEVICE_ID
        bool "Either mqtt uses mac address in place of device id or user provides one"
        default false
endmenu
```

## service-alerts-device/components/iotcore/output_devices/Kconfig
```kconfig
menu "Output Devices"
    menu "LED"
        config ENABLE_LED
            bool "Enable LED"
            default y
    endmenu
    menu "WS2812b"
        config ENABLE_WS2812B
            bool "Enable WS2812B LED Strip"
            default n
        if ENABLE_WS2812B
            rsource "displays/ws2812b/Kconfig"
        endif
    endmenu
            
endmenu
```

## service-alerts-device/components/iotcore/output_devices/displays/ws2812b/Kconfig
```kconfig
menu "ws2812b-led-strip Configuration"
    config RMT_TX_GPIO
        int "RMT TX GPIO"
        default 18
        help
            Set the GPIO number used for transmitting the RMT signal.

    config STRIP_LED_NUMBER
        int "Number of LEDS in a strip"
        default 8
        help
            A single RGB strip contains several LEDs.
endmenu
```

## service-alerts-device/components/iotcore/storage/Kconfig
```kconfig
menu "Storage"

    menu "Non-Volatile Storage"
        menu "NVS"
            config ENABLE_NVS
                bool "Enable NVS"
                default n
        endmenu
        menu "SD CARD"
            config ENABLE_SDCARD
                bool "Enable SD Card"
                default n
            if ENABLE_SDCARD
                rsource "sdcard/Kconfig"
            endif
        endmenu
    
    endmenu

    menu "Volatile Storage"

        config ENABLE_IN_MEMORY_DICTIONARY
            bool "Enable in-memory dictionary"
            default n
    
    endmenu

    config ENABLE_LITTLEFS
        bool "Enable LittleFS"
        default n
    if ENABLE_LITTLEFS
        rsource "file_management/littlefs/Kconfig"
    endif
endmenu
```

## service-alerts-device/components/iotcore/storage/sdcard/Kconfig
```kconfig
menu "SD Card Configuration"

    choice Select_Communication_Mode
        prompt "Communication Mode"
        default USE_SPI
        config USE_SPI
            bool "USE SPI"
        config USE_SD_BUS
            bool "USE SD BUS"
    endchoice

    config PIN_NUM_MISO
        depends on USE_SPI
        default 2
        int "PIN NUM MISO"
    
    config PIN_NUM_MOSI
        depends on USE_SPI
        default 15
        int "PIN NUM MOSI"
    config PIN_NUM_CLK
        depends on USE_SPI
        default 14
        int "PIN NUM CLK"
    config PIN_NUM_CS
        depends on USE_SPI
        default 13
        int "PIN NUM CS"

    

    config PIN_CMD
        depends on USE_SD_BUS
        default 15
        int "CMD PIN"
    config PIN_D0
        depends on USE_SD_BUS
        default 2
        int "PIN D0"
    config PIN_D1
        depends on USE_SD_BUS
        default 4
        int "PIN D1"
    config PIN_D2
        depends on USE_SD_BUS
        default 12
        int "PIN D2"
    config PIN_D3
        depends on USE_SD_BUS
        default 13
        int "PIN D3"
    
endmenu
```

## service-alerts-device/components/iotcore/system/Kconfig
```kconfig
menu "System config"

    config ENABLE_OTA
        bool "Enable OTA"
        default n
        help
            Enable or disable OTA
    
    config MAX_OTA_RETRIES
        depends on ENABLE_OTA
        int "Max OTA retries"
        default 5
        help
            The maximum number of OTA retries to be allowed
    
    config HTTP_FILE_DOWNLOAD_TASK_PRIORITY
        depends on ENABLE_OTA
        int "Task priority for HTTP download of OTA"
        default 10
        range 1 24
        help
            The task priority for HTTP download of OTA. Highest priority is 24.
        
    if ENABLE_OTA
        rsource "firmware_updates/delta_ota/Kconfig"
    endif
    
    config NATIVE_OTA_TASK_PRIORITY
        depends on ENABLE_OTA
        int "Native OTA Task Priority"
        default 10
        range 1 24
        help
            The native OTA task priority. Highest priority is 24.

    config ENABLE_SYSTEM_MONITORING
        bool "Enable system monitoring features"
        default y
        depends on ENABLE_NVS && ENABLE_IOTCORE_EVENTS

    config ENABLE_SYSTEM_STATUS_REPORTING
            bool "Enable system reporting features"
            default y
            depends on ENABLE_SYSTEM_MONITORING
    
        
endmenu
```
