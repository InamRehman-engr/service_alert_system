## service-alerts-device/components/iotcore/Kconfig
```kconfig
# parent_config
menu "IoT Core"

    menu "Configs"

        # Application level configs for IoT core project. Like device type, etc.
        rsource "utils/Kconfig"
        rsource "core/Kconfig"
        rsource "storage/Kconfig"
        rsource "system/Kconfig"
    endmenu

    menu "Drivers & Hardware config"

        rsource "networking/Kconfig"  # Networking related Kconfig
        rsource "output_devices/Kconfig"
        rsource "hardware/Kconfig"

    endmenu
    

    menu "Iotcore Default app"
        config IOTCORE_MQTT_DEFAULT_CLIENT
            bool "Enable iotcore's default mqtt client. Will come with event listener. Otherwise user will need to implement himself"
            depends on ENABLE_MQTT #Make dependency on actual app_mqtt
            default y
        if IOTCORE_MQTT_DEFAULT_CLIENT
            # This will be implemented in app_iotcore.c
            menu "Iotcore Default MQTT Configuration"
            config IOTCORE_MQTT_DEFAULT_CLIENT_TRANSPORT
                string "Default MQTT Client Transport"
                depends on IOTCORE_MQTT_DEFAULT_CLIENT
                default "mqtt"
                help
                    Select the default transport protocol for the MQTT client.
                    Options:
                    - mqtt: Standard MQTT over TCP.
                    - ws: MQTT over WebSocket.
                    - wss: MQTT over WebSocket Secure
            config IOTCORE_MQTT_DEFAULT_USERNAME
                string "MQTT Username"
                depends on IOTCORE_MQTT_DEFAULT_CLIENT
                default ""
                help
                    Enter the username for MQTT authentication.
    
            config IOTCORE_MQTT_DEFAULT_PASSWORD
                string "MQTT Password"
                depends on IOTCORE_MQTT_DEFAULT_CLIENT
                default ""
                help
                    Enter the password for MQTT authentication.
    
            config IOTCORE_MQTT_DEFAULT_HOST
                string "MQTT Broker Host"
                depends on IOTCORE_MQTT_DEFAULT_CLIENT
                default "localhost"
                help
                    Enter the hostname or IP address of the MQTT broker. 
                    For example, 'broker.example.com' or '192.168.1.100'.
    
            #Keeping this string here helps a lot with string formatting down the line
            config IOTCORE_MQTT_DEFAULT_PORT
                string "Specify port for mqtt"
                depends on IOTCORE_MQTT_DEFAULT_CLIENT
                default "1883"

            endmenu
        endif
        config IOTCORE_SERVER_API_DEFAULT_CONFIG
            bool "Enable the iotcore app to perform default onboarding"
            depends on ENABLE_IOTCORE_SERVER_API
            default y

        if IOTCORE_SERVER_API_DEFAULT_CONFIG
            config IOTCORE_SERVER_API_DEFAULT_CONFIG_URL
                string "URL String for api. example is https://localhost:8080/v1 . This will be default after which route can be called"
                default ""
            config IOTCORE_SERVER_API_DEFAULT_CONFIG_USERNAME
                string "/auth api email/username field"
                default ""
            config IOTCORE_SERVER_API_DEFAULT_CONFIG_PASSWORD
                string "/auth api password field"
        endif
    endmenu
    menu "Project settings"
        config CURRENT_FIRMWARE_SUB_VERSION
                int "firmware version sub"
                default 1
                range 0 200
                help
                    firmware version sub.   

        config CURRENT_FIRMWARE_MINOR_VERSION
                int "firmware version minor"
                default 0
                range 0 200
                help
                    firmware version minor.       

        config CURRENT_FIRMWARE_MAJOR_VERSION
                int "firmware version MAJOR"
                default 0
                range 0 200
                help
                    firmware version MAJOR.  
        config FW_IS_RC
                bool "Release Candidate"
                default n
        config FW_RC_NUM
                int "Release Candidate Version"
                default 0 
        config  DEVICE_HARDWARE_PREFIX #Ifdef checks should be comparing strings
                string "Hardware prefix. will be set as IAW_1.x where IAW is prefix"
                default "HW"

        config  HARDWARE_VERSION
                string "hardware version"
                default "1.x"
                help
                    hardware verison for which this c.

        config  DEVICE_TYPE_ID
                int "Device type ID"
                default 1
    endmenu 
    menu "Testing"
        config ENABLE_UNIT_TESTS
            bool "Enable Unit Tests"
            default n

        config ENABLE_INTEGRATION_TESTS
            bool "Enable Integration Tests"
            default n
    endmenu
endmenu
```

## service-alerts-device/components/iotcore/core/Kconfig
```kconfig
menu "Core lib"
    config ENABLE_BATTERY_CHARGING
        bool "Enable battery charging"
        default n
        help
            Enable or disable battery charging.
    if ENABLE_BATTERY_CHARGING
        rsource "battery_charging/Kconfig"
    endif
    config ENABLE_BILLING
        bool "Enable billing"
        default n
        help
            Enable or disable billing.
    
    config ENABLE_IOTCORE_EVENTS
        bool "Enable IoT Core events"
        default y
        help
            Enable or disable IoT Core events
    if ENABLE_IOTCORE_EVENTS
            rsource "events/Kconfig"
    endif

    config ENABLE_IOTCORE_SERVER_API
        bool "Enable HTTP Call"
        default n
        depends on REST_API_CLIENT
        help
            Enable or disable HTTP Call

    config ENABLE_IOTCORE_SERVER_API_EMBED_JSON
        bool "Enable embedding JSON"
        default n
        depends on ENABLE_IOTCORE_SERVER_API
        help
            Enable embedded device specific json

endmenu
```

## service-alerts-device/components/iotcore/core/battery_charging/Kconfig
```kconfig
menu "BATTERY_CHARGING"
    config BATTERY_VOLTAGE_ADC
        bool "Battery voltage messurement adc available"
        default n
        help
            Battery voltage messurement adc available
    config BATTERY_VOLTAGE_ADC_UNIT
        depends on BATTERY_VOLTAGE_ADC
        default 1
        int "Battery voltage messurement adc unit"
        range 0 1
        help
            Battery voltage messurement adc unit
    config BATTERY_VOLTAGE_ADC_CHANNEL
        depends on BATTERY_VOLTAGE_ADC
        int "Battery voltage messurement adc CHANNEL"
        range 0 9
        help
            Battery voltage messurement adc CHANNEL
    config BATTERY_VOLTAGE_ADC_R1
        depends on BATTERY_VOLTAGE_ADC
        int "Battery voltage messurement voltage divider R1in Kohm"
        default 8200
        help
            Battery voltage messurement voltage divider R1 in Kohm
    config BATTERY_VOLTAGE_ADC_R2
        depends on BATTERY_VOLTAGE_ADC
        int "Battery voltage messurement voltage divider R2 in Kohm"
        default 910
        help
            Battery voltage messurement voltage divider R2 in Kohm
                                                                       
    config BATTERY_CHARGE_STATUS
        bool "Battery charging PINS available"
        default n
        help
            Battery charging PINS available
    config BATTERY_CHARGE_STATUS_PIN
        depends on BATTERY_CHARGE_STATUS
        int "charging status Pin Number"
        default -1
        range -1 39
        help
            Pin number of charging status.
    config BATTERY_CHARGE_STDBY_PIN
        depends on BATTERY_CHARGE_STATUS
        int "chraging standby Pin Number"
        default -1
        range -1 39
        help
            Pin number ofchraging standby.
                       
endmenu
```

## service-alerts-device/components/iotcore/core/events/Kconfig
```kconfig
menu "Event Loop config"
    config IOTCORE_EVENT_LOOP_TASK_PRIORITY
        int "Task priority of event loop. Will be shared with all 3 events"
        default 5
    
    config IOTCORE_DATA_EVENT_HEAP_SIZE
        int "Heap size for comms event. This loop will be used for data so give it more than the rest"
        default 4096

    config IOTCORE_APP_EVENT_HEAP_SIZE
        int "Heap size for app event"
        default 2048
    
    config IOTCORE_ERROR_EVENT_HEAP_SIZE
        int "Heap size for error event"
        default 2048
        
                
    config IOTCORE_EVENT_QUEUE_SIZE
        int "queue size for tha number of max events"
        default 20

endmenu
```

## service-alerts-device/components/iotcore/hardware/Kconfig
```kconfig
menu "Hardware"
    # config ENABLE_HARDWARE
    #     bool "Enable hardware components of esp32"
    #     default n
    # if ENABLE_HARDWARE
    #     rsource "peripherals/Kconfig"
    # endif

    rsource "communication_interfaces/Kconfig"
    rsource "sensors/Kconfig"
    rsource "peripherals/Kconfig"
    rsource "power/Kconfig"

endmenu
```

## service-alerts-device/components/iotcore/hardware/communication_interfaces/Kconfig
```kconfig
menu "Communication Interfaces"
    config ENABLE_MODBUS
        bool "Enable Modbus"
        default n

    config ENABLE_RS485
        bool "Enable RS485"
        default n

endmenu
```
