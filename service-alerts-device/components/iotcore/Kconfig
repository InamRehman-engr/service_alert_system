## service-alerts-device/components/iotcore/hardware/peripherals/Kconfig
```kconfig
menu "Hardware Peripherals"
    menu "ADC"
        config HARDWARE_ADC
            bool "Enable hardware ADC"
            help
               Hardware ADC component of esp will be enabled. 
               Some models of ESP have problem with adc being used and wifi being on at the same time and will give errors. 
               That is the headache for the user.
            default n
        if HARDWARE_ADC
            rsource "adc/Kconfig"
        endif
    endmenu
    menu "I2C"
        config HARDWARE_I2C
            bool "Enable I2C hardware"
            help
               enable esp i2c
            default n
        if HARDWARE_I2C
            rsource "i2c/Kconfig"
        endif
    endmenu
    menu "UART"
        config ENABLE_HARDWARE_UART
        bool "Enable UART"
        default n

        if ENABLE_HARDWARE_UART
            rsource "uart/Kconfig"
        endif
    endmenu
    menu "SPI Master"
        config  HARDWARE_SPI_MASTER
            bool "Enable SPI hardware"
            help
               enable esp SPI
            default n
    if HARDWARE_SPI_MASTER
        rsource "spi_master/Kconfig"
    endif
    endmenu

    menu "RTC"
        config ENABLE_APP_RTC
            bool "Enable RTC"
            default n
            help
                Enable/Disable App RTC

            config TIMEZONE_OFFSET
                depends on ENABLE_APP_RTC
                int
                default -720 if TIMEZONE_UTC_MINUS_12
                default -660 if TIMEZONE_UTC_MINUS_11
                default -600 if TIMEZONE_UTC_MINUS_10
                default -570 if TIMEZONE_UTC_MINUS_9_30
                default -540 if TIMEZONE_UTC_MINUS_9
                default -480 if TIMEZONE_UTC_MINUS_8
                default -420 if TIMEZONE_UTC_MINUS_7
                default -360 if TIMEZONE_UTC_MINUS_6
                default -300 if TIMEZONE_UTC_MINUS_5
                default -240 if TIMEZONE_UTC_MINUS_4
                default -210 if TIMEZONE_UTC_MINUS_3_30
                default -180 if TIMEZONE_UTC_MINUS_3
                default -120 if TIMEZONE_UTC_MINUS_2
                default -60 if TIMEZONE_UTC_MINUS_1
                default 0 if TIMEZONE_UTC
                default 60 if TIMEZONE_UTC_PLUS_1
                default 120 if TIMEZONE_UTC_PLUS_2
                default 180 if TIMEZONE_UTC_PLUS_3
                default 210 if TIMEZONE_UTC_PLUS_3_30
                default 240 if TIMEZONE_UTC_PLUS_4
                default 270 if TIMEZONE_UTC_PLUS_4_30
                default 300 if TIMEZONE_UTC_PLUS_5
                default 330 if TIMEZONE_UTC_PLUS_5_30
                default 345 if TIMEZONE_UTC_PLUS_5_45
                default 360 if TIMEZONE_UTC_PLUS_6
                default 390 if TIMEZONE_UTC_PLUS_6_30
                default 420 if TIMEZONE_UTC_PLUS_7
                default 480 if TIMEZONE_UTC_PLUS_8
                default 525 if TIMEZONE_UTC_PLUS_8_45
                default 540 if TIMEZONE_UTC_PLUS_9
                default 570 if TIMEZONE_UTC_PLUS_9_30
                default 600 if TIMEZONE_UTC_PLUS_10
                default 630 if TIMEZONE_UTC_PLUS_10_30
                default 660 if TIMEZONE_UTC_PLUS_11
                default 720 if TIMEZONE_UTC_PLUS_12
                default 765 if TIMEZONE_UTC_PLUS_12_45
                default 780 if TIMEZONE_UTC_PLUS_13
                default 840 if TIMEZONE_UTC_PLUS_14

                
            choice
                depends on ENABLE_APP_RTC
                prompt "Timezone Configuration"
                default TIMEZONE_UTC
        
                config TIMEZONE_UTC_MINUS_12
                    bool "UTC-12:00"
                config TIMEZONE_UTC_MINUS_11
                    bool "UTC-11:00"
                config TIMEZONE_UTC_MINUS_10
                    bool "UTC-10:00"
                config TIMEZONE_UTC_MINUS_9_30
                    bool "UTC-09:30"
                config TIMEZONE_UTC_MINUS_9
                    bool "UTC-09:00"
                config TIMEZONE_UTC_MINUS_8
                    bool "UTC-08:00"
                config TIMEZONE_UTC_MINUS_7
                    bool "UTC-07:00"
                config TIMEZONE_UTC_MINUS_6
                    bool "UTC-06:00"
                config TIMEZONE_UTC_MINUS_5
                    bool "UTC-05:00"
                config TIMEZONE_UTC_MINUS_4
                    bool "UTC-04:00"
                config TIMEZONE_UTC_MINUS_3_30
                    bool "UTC-03:30"
                config TIMEZONE_UTC_MINUS_3
                    bool "UTC-03:00"
                config TIMEZONE_UTC_MINUS_2
                    bool "UTC-02:00"
                config TIMEZONE_UTC_MINUS_1
                    bool "UTC-01:00"
                config TIMEZONE_UTC
                    bool "UTC+00:00"
                config TIMEZONE_UTC_PLUS_1
                    bool "UTC+01:00"
                config TIMEZONE_UTC_PLUS_2
                    bool "UTC+02:00"
                config TIMEZONE_UTC_PLUS_3
                    bool "UTC+03:00"
                config TIMEZONE_UTC_PLUS_3_30
                    bool "UTC+03:30"
                config TIMEZONE_UTC_PLUS_4
                    bool "UTC+04:00"
                config TIMEZONE_UTC_PLUS_4_30
                    bool "UTC+04:30"
                config TIMEZONE_UTC_PLUS_5
                    bool "UTC+05:00"
                config TIMEZONE_UTC_PLUS_5_30
                    bool "UTC+05:30"
                config TIMEZONE_UTC_PLUS_5_45
                    bool "UTC+05:45"
                config TIMEZONE_UTC_PLUS_6
                    bool "UTC+06:00"
                config TIMEZONE_UTC_PLUS_6_30
                    bool "UTC+06:30"
                config TIMEZONE_UTC_PLUS_7
                    bool "UTC+07:00"
                config TIMEZONE_UTC_PLUS_8
                    bool "UTC+08:00"
                config TIMEZONE_UTC_PLUS_8_45
                    bool "UTC+08:45"
                config TIMEZONE_UTC_PLUS_9
                    bool "UTC+09:00"
                config TIMEZONE_UTC_PLUS_9_30
                    bool "UTC+09:30"
                config TIMEZONE_UTC_PLUS_10
                    bool "UTC+10:00"
                config TIMEZONE_UTC_PLUS_10_30
                    bool "UTC+10:30"
                config TIMEZONE_UTC_PLUS_11
                    bool "UTC+11:00"
                config TIMEZONE_UTC_PLUS_12
                    bool "UTC+12:00"
                config TIMEZONE_UTC_PLUS_12_45
                    bool "UTC+12:45"
                config TIMEZONE_UTC_PLUS_13
                    bool "UTC+13:00"
                config TIMEZONE_UTC_PLUS_14
                    bool "UTC+14:00"
            endchoice
    endmenu
endmenu
```

## service-alerts-device/components/iotcore/hardware/peripherals/i2c/Kconfig
```kconfig
menu "I2C Configuration"   
    config SMBUS_SUPPORT
        bool "Enable SMBUS"
        default false
endmenu
```

## service-alerts-device/components/iotcore/hardware/peripherals/uart/Kconfig
```kconfig
menu "UART Configuration"

    config UART_BUFFER_SIZE
        int "UART BUFFER SIZE"
        default 1024
        help
            UART BUFFER SIZE.        
endmenu
```

## service-alerts-device/components/iotcore/hardware/power/Kconfig
```kconfig
menu "Power Configurations"
    config ENABLE_SBS_BATTERY
        bool "Enable SBS Battery"
        default n
    config BQ_ADDRESS
        hex "Battery BQ Address"
        default 0x0B
        depends on ENABLE_SBS_BATTERY
endmenu
```

## service-alerts-device/components/iotcore/hardware/sensors/Kconfig
```kconfig
menu "Sensors"

    menu "Air Quality Sensor"
        rsource "air_quality/Kconfig"
    endmenu

    menu "Energy Metering"
        rsource "energy/Kconfig"
    endmenu

    menu "Current Sensors"
            rsource "current/Kconfig"
    endmenu

    menu "Gas Sensors"
        config ENABLE_MC106
            bool "Enable MC106 Sensor"
            default n

            config MC106_ADC_UNIT
                int "ADC Unit"
                depends on ENABLE_MC106
                default 2
            config MC106_ADC_CHANNEL_A
                int "ADC Unit"
                depends on ENABLE_MC106
                default 1
            config MC106_ADC_CHANNEL_B
                int "ADC Unit"
                depends on ENABLE_MC106
                default 2

        config ENABLE_MICS5524
            bool "Enable MICS5524 Sensor"
            default n

            config MiCS_5524_ADC_UNIT
                int "ADC Unit"
                default 1
                depends on ENABLE_MICS5524

            config MiCS_5524_ADC_CHANNEL
                int "ADC Unit"
                default 1
                depends on ENABLE_MICS5524


        config ENABLE_MP5
            bool "Enable MP5 Sensor"
            default n

            config MP_5_ADC_UNIT
                int "ADC Unit"
                depends on ENABLE_MP5
                range 1 2
                default 2

            config MP_5_ADC_CHANNEL_A
                int "ADC Unit"
                depends on ENABLE_MP5
                default 1

            config MP_5_ADC_CHANNEL_B
                int "ADC Unit"
                depends on ENABLE_MP5
                default 2

            
        config ENABLE_MQ7B
            bool "Enable MQ7B Sensor"
            default n

        config MQ_7b_ADC_UNIT
            int "ADC Unit"
            depends on ENABLE_MQ7B
            range 1 2
            default 2

        config MQ_7b_ADC_CHANNEL_A
            int "ADC Unit"
            depends on ENABLE_MQ7B
            default 1

        config MQ_7b_ADC_CHANNEL_B
            int "ADC Unit"
            depends on ENABLE_MQ7B
            default 2

    endmenu

    menu "Heart Rate Sensor"
            rsource "heart_rate_monitor/Kconfig"
    endmenu

    menu "Temperature & Humidity Sensors"
        rsource "humidity_temperature/Kconfig"
    endmenu

    menu "Motion Sensors"
        rsource "motion/Kconfig"
    endmenu

    menu "Position Sensor"
        rsource "position_sensor/Kconfig"
    endmenu

    menu "Pressure Sensors"
        rsource "pressure/Kconfig"
    endmenu

    menu "Light Sensors"
        config ENABLE_OPT101
            bool "Enable OPT101 Sensor"
            default n

            config OPT101_ADC_UNIT
                int "ADC Unit"
                range 1 2
                default 2
                depends on ENABLE_OPT101

            config OPT101_ADC_CHANNEL
                int "ADC Channel to be Used"
                range 0 10
                default 0
                depends on ENABLE_OPT101

        config ENABLE_OPT3001
            bool "Enable OPT3001 Sensor"
            default n

        config ENABLE_TSL2561
            bool "Enable TSL2561 Sensor"
            default n

            config TSL2561_I2C_ADDRESS
                hex "I2C Address for TSL2561 device"
                default 0x49
                depends on ENABLE_TSL2561
                help
                    I2C address for TSL2561 device.
                    If ADDR Sel pin is tied to GND, the address is 0x29.
                    If ADDR Sel pin is floating, the address is 0x39.
                    If ADDR Sel pin is tied to VCC, the address is 0x49.
    endmenu
        menu "Sensor Wrapper lib for Temperature and humidity sensors"
        config ENABLE_TEMPERATURE_HUMIDITY_SENSOR_WRAPPER
            bool "Enable Sensor wrapper library"
            default n
            help
                Enable or disable TH wrapper

            config TEMP_HUM_I2C_SDA_PIN
                int "SDA PIN"
                default 26
                depends on ENABLE_TEMPERATURE_HUMIDITY_SENSOR_WRAPPER
                help
                    SDA PIN FOR SPECIFIC SENSOR

            config TEMP_HUM_I2C_SCL_PIN
                int "SCL PIN"
                default 27
                depends on ENABLE_TEMPERATURE_HUMIDITY_SENSOR_WRAPPER
                help
                    SCL PIN FOR SPECIFIC SENSOR
        
            config I2C_MASTER_SCL
                int "I2C Master SCL GPIO number"
                range 0 34
                default 23
                depends on ENABLE_TEMPERATURE_HUMIDITY_SENSOR_WRAPPER
                help
                    GPIO number (IOxx) for I2C SCL.
                    Some GPIOs are used for other purposes (flash connections, etc.) and cannot be used.
                    GPIOs 35-39 are input-only so cannot be used to drive the One Wire Bus.

            config I2C_MASTER_SDA
                int "I2C Master SDA GPIO number"
                range 0 34
                default 22
                depends on ENABLE_TEMPERATURE_HUMIDITY_SENSOR_WRAPPER
                help
                    GPIO number (IOxx) for I2C SDA.
                    Some GPIOs are used for other purposes (flash connections, etc.) and cannot be used.
                    GPIOs 35-39 are input-only so cannot be used to drive the One Wire Bus.
    endmenu
endmenu
```

## service-alerts-device/components/iotcore/hardware/sensors/current/Kconfig
```kconfig
config ENABLE_CURRENT_TRANSFORMER
    bool "Enable Current Transformer"
    default n
    
config ENABLE_INA219
    bool "Enable INA219 Sensor"
    default n

config ENABLE_INA226
    bool "Enable INA226 Sensor"
    default n
```

## service-alerts-device/components/iotcore/hardware/sensors/energy/Kconfig
```kconfig
menu "ADE7758 Sensor IC"
    config ENABLE_ADE7758
        bool "Enable ADE7758 Sensor IC"
        default n
endmenu
```

## service-alerts-device/components/iotcore/hardware/sensors/heart_rate_monitor/Kconfig
```kconfig
config ENABLE_PPSI262
    bool "Enable PPSI262"
    default n

config ENABLE_MAX30102
    bool "Enable MAX30102 Sensor"
    default n
```

## service-alerts-device/components/iotcore/hardware/sensors/humidity_temperature/Kconfig
```kconfig
config ENABLE_SHTC3
    bool "Enable SHTC3 Sensor"
    default n
    
config ENABLE_SI7006_A20
    bool "Enable SI7006_A20 Sensor"
    default n

config ENABLE_AHT10
    bool "Enable AHT10 Sensor"
    default n

config ENABLE_MAX31855K
    bool "Enable MAX31855K Sensor"
    default n
```

## service-alerts-device/components/iotcore/hardware/sensors/motion/Kconfig
```kconfig
menu "LSM6DSM"
    config ENABLE_LSM6DSM
    bool "Enable LSM6DSM Sensor"
    default n
    config SELF_TEST_ENABLE
    bool "Enable SELF TEST"
    default y
endmenu

config ENABLE_MPU6050
bool "Enable MPU6050 Sensor"
default n

config ENABLE_MPU9250
bool "Enable MPU9250 Sensor"
default n


menu "ICM20602"
    config ENABLE_ICM20602
        bool "Enable ICM20602"
        default n
endmenu
```

## service-alerts-device/components/iotcore/hardware/sensors/position_sensor/AS5045/Kconfig
```kconfig
     config ENABLE_AS5045
         bool "Enable AS5045 position sensor"
         default n
```
