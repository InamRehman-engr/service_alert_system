## service-alerts-device/components/iotcore/networking/Kconfig
```kconfig
menu "Networking Configuration"
    menu "Connectivity"

        menuconfig ENABLE_WIFI
            bool "Enable WiFi"
            default y
            help
                Enable or disable WiFi support in your project.
                Enabling WiFi may require additional configuration and libraries.        
        if ENABLE_WIFI
            rsource "connectivity/wifi/Kconfig"
        endif

        config ENABLE_ETHERNET
            bool "Enable Ethernet"
            default n
            help
                Enable or disable Ethernet support in your project.
                Enabling Ethernet may require additional configuration and libraries
        if ENABLE_ETHERNET
            rsource "connectivity/ethernet/Kconfig"
        endif

        config ENABLE_BLE
            bool "Enable BLE"
            default n
            help
                Enable or disable BLE support in your project.
        if ENABLE_BLE
            rsource "connectivity/ble/Kconfig"
        endif

        config ENABLE_MODEM
            bool "Enable MODEM Component"
            depends on LWIP_PPP_SUPPORT
            default n
            help
               Turns on support for modem component. Need LWIP_PPP_SUPPORT to be enabled in LWIP config
        if ENABLE_MODEM
            rsource "connectivity/modem/Kconfig"
        endif
        config ENABLE_GSM
            bool "Enable GSM"
            default n
            help
                Enable or disable GSM support.

        config ENABLE_EPPP_CLIENT
            depends on ENABLE_EPPP_LINK
            bool "Enable default EPPP Client"
            default n
            help
                Enable or disable EPPP_LINK as a network provider in your project.

        config PING_IP_ADDRESS
            string "IP Address for Ping Service"
            default "8.8.8.8"
            help
                Enter IP address for ping service. Uses Google DNS 8.8.8.8 by default.

        config PING_INTERVAL_MS
            int "Ping Interval in milliseconds"
            default 3000
            help
                Enter interval in milliseconds between subsequent pings. Uses 3000 milliseconds by default.

        config PING_TIMEOUT_MS
            int "Ping Timeout in milliseconds"
            default 2000
            help
                Enter time in milliseconds for ping to timeout. Uses 2000 milliseconds by default.
        
        config MAX_PING_FAILURES
            int "Maximum Ping Failures"
            default 15
            help
                Enter maximum number of ping failures allowed. Exceeding this number means network lost. Set to 15 by default 
    endmenu

    menu "Protocols"
        config ENABLE_HTTP_SERVER
            bool "Enable HTTP Server"
            default y
            help 
                Enable or disable HTTP server.

        config ENABLE_SOCKETS
            bool "Enable TCP sockets"
            default y
            help 
                Enable or disbale TCP sockets.
        
        config ENABLE_MQTT
            bool "Enable MQTT"
            default y 
            help
                Enable for disable MQTT functionality.
            if ENABLE_MQTT
                rsource "protocols/mqtt/Kconfig"
            endif

        config REST_API_CLIENT
            bool "Enable rest client"
            default n
            help
              Client for providing functionality of making http/s calls
            rsource "protocols/REST_API_CLIENT/Kconfig"
        
        config ENABLE_EPPP_SERVER
            depends on ENABLE_EPPP_LINK
            bool "Enable EPPP Server"
            default n
            help
                Enables default server for providing Internet over EPPP Link
        
        config ENABLE_NETWORK_UI
            depends on ENABLE_WIFI
            bool "Enable Network Web UI"
            default n
            help
                Enables a basic web-based network configuration UI.

        
        config ENABLE_FIRMWARE_UPLOAD_UI
            depends on ENABLE_OTA
            bool "Enable Firmware Upload Web UI"
            default n
            help
                Enables the web-based UI for uploading firmware files over HTTP.

        
    endmenu

    menu "VHMI"
        config ENABLE_VHMI
            bool "Enable vHMI"
            default y
            help 
                Enable or disable the vHMI functionality.
    endmenu

    menu "EPPP Link"
        config ENABLE_EPPP_LINK
            bool "Enable EPPP Link"
            default n
            help
                Enable or disable EPPP_LINK as a network provider in your project. Needs LWIP_PPP_SUPPORT, LWIP_PPP_SERVER_SUPPORT, LWIP_IP_FORWARD and LWIP_IPV4_NAPT to be enabled in LWIP config
                Provides internet over UART (and SPI/SDPIO).
                    
        if ENABLE_EPPP_LINK
            rsource "eppp_link/Kconfig"
        endif
    endmenu
endmenu
```

## service-alerts-device/components/iotcore/networking/connectivity/ethernet/Kconfig
```kconfig
menu "Ethernet Configuration"

    orsource "$IDF_PATH/examples/common_components/env_caps/$IDF_TARGET/Kconfig.env_caps"

    choice
        prompt "Select Ethernet Type"
        default ENABLE_SPI_ETHERNET

        config ENABLE_INTERNAL_ETHERNET
            bool "Internal Ethernet"
            depends on IDF_TARGET_ESP32
            select ETH_USE_ESP32_EMAC

        config ENABLE_SPI_ETHERNET
            bool "SPI Internet"
            depends on ETH_SPI_ETHERNET_W5500
    endchoice

    if ENABLE_INTERNAL_ETHERNET
        choice EXAMPLE_ETH_PHY_MODEL
            prompt "Ethernet PHY Device"
            default ETH_PHY_LAN87XX
            help
                Select the Ethernet PHY device to use in the example.
            config ETH_PHY_LAN87XX
                bool "LAN87xx"
                help
                    Below chips are supported:
                    LAN8710A is a small footprint MII/RMII 10/100 Ethernet Transceiver with HP Auto-MDIX and
                        flexPWR® Technology.
                    LAN8720A is a small footprint RMII 10/100 Ethernet Transceiver with HP Auto-MDIX Support.
                    LAN8740A/LAN8741A is a small footprint MII/RMII 10/100 Energy Efficient Ethernet Transceiver
                        with HP Auto-MDIX and flexPWR® Technology.
                    LAN8742A is a small footprint RMII 10/100 Ethernet Transceiver with HP Auto-MDIX and
                        flexPWR® Technology.
                    Goto https://www.microchip.com for more information about them.
        endchoice
            
        menu "Ethernet PHY Configuration"

            config ETH_MDC_GPIO
            int "SMI MDC GPIO number"
            range ENV_GPIO_RANGE_MIN ENV_GPIO_OUT_RANGE_MAX
            default 23
            help
                Set the GPIO number used by SMI MDC.

        config ETH_MDIO_GPIO
            int "SMI MDIO GPIO number"
            range ENV_GPIO_RANGE_MIN ENV_GPIO_OUT_RANGE_MAX
            default 18
            help
                Set the GPIO number used by SMI MDIO.

        config ETH_PHY_RST_GPIO
            int "PHY Reset GPIO number"
            range -1 ENV_GPIO_OUT_RANGE_MAX
            default 5
            help
                Set the GPIO number used to reset PHY chip.
                Set to -1 to disable PHY chip hardware reset.

        config ETH_PHY_ADDR
            int "PHY Address"
            range 0 31
            default 1
            help
                Set PHY address according your board schematic
        endmenu
        
    endif

    if ENABLE_SPI_ETHERNET
        choice
            prompt "Select SPI Host"
            depends on ENABLE_ETHERNET
            default HSPI_HOST

            config HSPI_HOST
                bool "HSPI_HOST"
            config VSPI_HOST
                bool "VSPI Host"
        endchoice

        config ETH_SPI_HOST
            depends on ENABLE_ETHERNET
            int
            default 1 if HSPI_HOST
            default 2 if VSPI_HOST

        menu "Pin Configuration"
            config ETH_SPI_CS_PIN
                int "CS Pin"
                default 0
                range ENV_GPIO_RANGE_MIN ENV_GPIO_OUT_RANGE_MAX
                help
                    Pin number of SPI CS.

            config ETH_SPI_INT_PIN
                int "INT Pin"
                default -1
                range -1 ENV_GPIO_OUT_RANGE_MAX
                help
                    Pin number of Interrupt.

            config ETH_SPI_RST_PIN
                int "RST Pin"
                default -1
                range -1 ENV_GPIO_OUT_RANGE_MAX
                help
                    Pin number of Reset.
        endmenu

        menu "Ethernet Configuration"
            config ETH_PHY_ADDR
                int "PHY address"
                default 1
                range 0 31
                help
                    PHY address of SPI Ethernet.

            config ETH_SPI_CLK_SPEED
                int "SPI clock speed (MHz)"
                default 36
                range 34 80
                help
                    SPI clock speed for W5500.
        endmenu
    endif

endmenu
```
